## conf/layer.conf
```bitbake
BBPATH .= ":${LAYERDIR}"

BBFILES += "${LAYERDIR}/recipes-*/*/*.bb \
            ${LAYERDIR}/recipes-*/*/*.bbappend"

BBFILE_COLLECTIONS += "imx93frdm"
BBFILE_PATTERN_imx93frdm = "^${LAYERDIR}/"
BBFILE_PRIORITY_imx93frdm = "10"

LAYERSERIES_COMPAT_imx93frdm = "whinlatter"
```
